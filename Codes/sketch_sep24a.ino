#include <HardwareSerial.h>
#include <ODriveArduino.h>
#include <avr/io.h>
int count = 0;

//initialize the checksum lOOKUP array
unsigned short crctable16[256] =
{ 0x0000, 0x3D65, 0x7ACA, 0x47AF, 0xF594, 0xC8F1, 0x8F5E, 0xB23B, 0xD64D,
  0xEB28, 0xAC87, 0x91E2, 0x23D9, 0x1EBC, 0x5913, 0x6476, 0x91FF,
  0xAC9A, 0xEB35, 0xD650, 0x646B, 0x590E, 0x1EA1, 0x23C4, 0x47B2,
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  0x2316, 0x64B9, 0x59DC, 0xEBE7, 0xD682, 0x912D, 0xAC48
};

//Adjust the angle feedback from the incremental encoders, by subtracting from the offset and limit the angle values(-0.5pi:0.5pi)
float get_angle(float ref, float val)
{
  ref = ref - trunc(ref);
  val = val - trunc(val);
  if (ref < 0) {
    ref = ref + 1.0;
  }
  if (val < 0) {
    val = val + 1.0;
  }
  float diff = val - ref;
  if (diff > 0.5) {
    diff = diff - 1.0;
  }
  else if (diff < -0.5) {
    diff = diff + 1.0;
  }
  return diff * 2 * PI;
}
//Compute CRC16 for the stream native commands the odrive
unsigned short Compute_CRC16 (unsigned char bytes[], int size)
{
  unsigned short crc = 0x1337;
  int i;
  for (i = 3; i < size - 2; i++)
  {
    unsigned char b = bytes[i];
    /* XOR-in next input byte into MSB of crc, that's our new intermediate divident */
    unsigned char pos = (unsigned char) ((crc >> 8) ^ b);  /* equal: ((crc ^ (b << 8)) >> 8) */
    /* Shift out the MSB used for division per lookuptable and XOR with the remainder */
    crc = (unsigned short) ((crc << 8) ^ (unsigned short) (crctable16[pos]));
  }
  return crc;
}

//the idle axis Native command
byte msgidle[] = {0xAA, 0x09, 0x0A, 0xF2, 0x03, 0x82, 0x00, 0x01, 0x00, 0x01, 0x53, 0x5E, 0x64, 0xA8};
//closed loop control loop command
byte msgClControl[] = {0xAA, 0x09, 0x0A, 0xF3, 0x03, 0x82, 0x00, 0x01, 0x00, 0x08, 0x53, 0x5E, 0x8E, 0xB9};
/*TODO add the control mode torque*/
//The input torque command initially the input torque is zero(inputTorque[9] to inputTorque[12]), CRC16(For the packrt is inputTorque[15] to inputTorque[16])
byte inputTorque[] = {0xAA, 0xC, 0xE1, 0xF3, 0x03, 0xf9, 0x00, 0x04, 0x00, 0x00, 0x00, 0x00, 0x00, 0x53, 0x5E, 0xB5, 0xC4};/*needs CRC16 check*/
//the command for getting the position for encoder0(Link 2)
byte reqPos2[] = {0xAA, 0x08, 0x3D, 0x8C, 0x03, 0x37, 0x81, 0x04, 0x00, 0x53, 0x5E, 0xF0, 0x09};
//the command for getting the velocity for encoder0(Link 2)
byte reqVel2[] = {0xAA, 0x08, 0x3D, 0xD5, 0x03, 0x3D, 0x81, 0x04, 0x00, 0x53, 0x5E, 0xF7, 0x9B};
//the command for getting the position for encoder1(Link 1)
byte reqPos1[] = {0xAA, 0x08, 0x3D, 0xF0, 0x03, 0x69, 0x82, 0x04, 0x00, 0x53, 0x5E, 0xC1, 0x57};
//the command for getting the velocity for encoder1(Link 1)
byte reqVel1[] = {0xAA, 0x08, 0x3D, 0xF4, 0x03, 0x6F, 0x82, 0x04, 0x00, 0x53, 0x5E, 0x73, 0xB7};

volatile float u_t, qp, q, dq, endstopPos, endstopvel;
static uint32_t oldtime;
float offset;
// 3.19521  1.00249
float L1 = 3.12969; float L2 = 1.00244;
union u_tag {
  byte b[4];
  float fval;
} u;

void setup()
{ Serial.begin(115200);
  Serial1.begin(115200);
  Serial1.setTimeout(1);
  while (!Serial);
  //input torque = 0
 
  Serial1.write(reqPos2, sizeof(reqPos2));
  //we are only interested in the position value, hence ignore the rest of the message
  /*TODO: check if the package is valid and not corrupted*/
  while (Serial1.available() > 0) {
    byte c = Serial1.read();
    Serial.println(c,HEX);
    if (count > 4 && count < 9) {
      u.b[count - 5] = c;
    }
    count++;
  }
  offset = u.fval;
  endstopPos = u.fval;
  q = get_angle(offset, endstopPos);
  oldtime = millis();
}

void loop()
{ if ( (millis() - oldtime) > 1000) {
    oldtime = millis();
    //odrive_serial << "r axis0.encoder.pos_estimate\n";
    Serial1.write(reqPos2, sizeof(reqPos2));
    while (Serial1.available() > 0) {
      byte c = Serial1.read();
      Serial.println(c,HEX);
      if (count > 4 && count < 9) {
        u.b[count - 5] = c;
      }
      count++;
    }
    //endstopPos = odrive_serial.readString().toFloat();
    endstopPos = u.fval;
    q = get_angle(offset, endstopPos);
    Serial.println("position");
    Serial.println(u.b[0], HEX);
    Serial.println(u.b[1], HEX);
    Serial.println(u.b[2], HEX);
    Serial.println(u.b[3], HEX);
    Serial.println(u.fval);
    //odrive_serial << "r axis0.encoder.vel_estimate\n";

  }
}
